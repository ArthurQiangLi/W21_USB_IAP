/**
  ******************************************************************************
  * @file    task_usb.c
  * @author  SeanLi
  * @version 
  * @date    29-December-2017
  * @brief   
  *
  *                      
  ******************************************************************************
  * @attention
  *
  *
  ******************************************************************************
  */

/*******************************************************************************
************************************ Includes **********************************
*******************************************************************************/


#include "FreeRTOS.h"
#include "task.h"
#include "cmsis_os.h"

#include "task_usb.h"
#include "msg_start.h"

#include "bsp_io.h"
#include "usbh_iap.h"

/*******************************************************************************
******************************** Private typedef *******************************
*******************************************************************************/

/*******************************************************************************
******************************** Private define ********************************
*******************************************************************************/

/*******************************************************************************
********************************* Private macro ********************************
*******************************************************************************/

/*******************************************************************************
******************************* Private variables ******************************
*******************************************************************************/

extern QueueHandle_t		g_queue_start_led;
msg_start_led_t				s_msg_led;
bsp_u16						s_boot;
usbh_iap_state_t			s_fsm;

/*******************************************************************************
************************** Private function prototypes *************************
*******************************************************************************/

/*******************************************************************************
******************************* Private functions ******************************
*******************************************************************************/


/*******************************************************************************
  * @brief  task_usb_creat_sem
  *
  * @param  none
  *
  * @retval none
  *****************************************************************************/
void task_usb_creat_sem(void)
{
	
}

/*******************************************************************************
  * @brief  task_usb
  *
  * @param  * argument
  *
  * @retval none
  *****************************************************************************/
void task_usb(void const * argument)
{
	osDelay(200);
	s_msg_led = MSG_START_LED_INIT;
	xQueueSend(g_queue_start_led, &s_msg_led, 0);
	osDelay(1500);
	
	//0 检测到U盘
	//1 未检测到U盘，未检测到APP
	//2 未检测到U盘，检测到APP  无法返回
	s_boot = usbh_iap_boot();
	
	if(s_boot != 0){
		s_msg_led = MSG_START_LED_ERROR;
		xQueueSend(g_queue_start_led, &s_msg_led, 0);
		
		while(1){
			osDelay(100);
		}
	}
	
	while(1){
		s_fsm = usbh_iap_polling();
		
		if(s_fsm == USBH_IAP_END){
			s_msg_led = MSG_START_LED_FINISH;
			xQueueSend(g_queue_start_led, &s_msg_led, 0);
			
		}else if(s_fsm == USBH_IAP_ERROR){
			s_msg_led = MSG_START_LED_ERROR;
			xQueueSend(g_queue_start_led, &s_msg_led, 0);
		}
		
		osDelay(100);
	}
}


/********************************* end of file ********************************/
